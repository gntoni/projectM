/dts-v1/;
/plugin/;

/{
       manufacturer = "PM";
       model = "PM,ttyO2 overlay";
       serial-number = "1000000001";
       part-number = "PM-GPIO-UART2";
       compatible = "ti,beaglebone", "ti,beaglebone-black";
       /* Identification */
       /* Version */
       version = "00A0";
       board-name = "PM-GPIO-UART2";

       /* state the resources this cape uses */
       exclusive-use =
           /* the pin header uses */
           "P9.21", /* UART2 TXD */
           "P9.22", /* UART2 RXD */

           /* the hardware IP use */
           "uart2_txd", 
           "uart2_rxd";

       fragment@0 {
           target = <&am33xx_pinmux>;
           __overlay__ {
               uart2_pins: pinmux_bb_uart2_pins {
                   pinctrl-single,pins = < 
                       0x154 0x01  /* P9_24 = GPIO0_15 = spi0_d0.uart2_txd, OUTPUT */
                       0x150 0x21  /* P9_26 = GPIO0_14 = spi0_sclk.uart2_rxd, INPUT */
                   >;
               };
          };
       };

       fragment@1 {
           target = <&uart3>; /* really uart2 */
           __overlay__{
               pinctrl-names   = "default";
               pinctrl-0        = <&uart2_pins>;
               status           = "okay";
           };
       };

};
