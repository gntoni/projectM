/dts-v1/;
/plugin/;

/{
  manufacturer = "PM";
  model = "PM,ttyO4 overlay";
  serial-number = "1000000001";
  part-number = "PM-GPIO-UART4";
  compatible = "ti,beaglebone", "ti,beaglebone-black";
  /* Identification */
  /* Version */
  version = "00A0";
  board-name = "PM-GPIO-UART4";

  /* state the resources this cape uses */
  exclusive-use =
    /* the pin header uses */
    "P9.13", /* UART4 TXD */
    "P9.11", /* UART4 RXD */

    /* the hardware IP use */
    "uart4_txd_mux2", 
    "uart4_rxd_mux2";

  fragment@0 {
    target = <&am33xx_pinmux>;
    __overlay__ {
      uart4_pins: pinmux_uart4_pins {
        pinctrl-single,pins = < 
          0x074 0x06 /* P9_13 = GPIO0_31 = gpmc_wpn.uart4_txd_mux2, OUTPUT */
          0x070 0x26 /* P9_11 = GPIO0_30 = gpmc_wait0.uart4_rxd_mux2, INPUT */
        >;
      };
    };
  };

  fragment@1 {
    target = <&uart5>; /* really uart4 */
    __overlay__ {
      pinctrl-names = "default";
      pinctrl-0     = <&uart4_pins>;
      status        = "okay";
    };
  };

};
