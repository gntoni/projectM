/dts-v1/;
/plugin/;

/{
  board-name = "PM-GPIO-I2C2";
  manufacturer = "sfoix";
  model = "PM,I2C2 overlay";
  serial-number = "1000000001";
  part-number = "PM-GPIO-I2C2";
  compatible = "ti,beaglebone", "ti,beaglebone-black";
  /* Identification */
  /* Version */
  version = "00A0";

  /* state the resources this cape uses */
  exclusive-use =
    /* I2C2 pins */
    "P9.17", /* I2C1_SCL */
    "P9.18", /* I2C1_SDA */

    /* Hardware IP cores in use */
    "i2c2_scl",
    "i2c2_sda";

  fragment@0 {
    target = <&am33xx_pinmux>;
    __overlay__ {
      i2c2_pins: pinmux_i2c2_pins {
        pinctrl-single,pins = <
          0x17c 0x73 /* P9_19 uart1_rtsn.i2c2_scl, SLEWCTRL_SLOW | INPUT_PULLUP | MODE3 */
          0x178 0x73 /* P9_20 uart1_ctsn.i2c2_sda, SLEWCTRL_SLOW | INPUT_PULLUP | MODE3 */
        >;
      };
    };
  };

  fragment@1 {
    target = <&i2c2>;
    __overlay__ {
      compatible      = "i2c2_test";
      pinctrl-names   = "default";
      pinctrl-0       = <&i2c2_pins>;
      clock-frequency = <100000>;
      #address-cells  = <1>;
      #size-cells     = <0>;
      status          = "okay";
    };
  };

};
